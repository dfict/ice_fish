// Drum sample //

#define SAMPLE_RATE 22050
#define SIZE 256
#define LED_PIN     13
#define LED_PORT    PORTB
#define LED_BIT     5
#define SPEAKER_PIN 11

const byte kick[] = {
    254, 63, 249, 171, 97, 255, 169, 66,
    223, 109, 230, 130, 184, 18, 88, 91,
    153, 99, 92, 66, 212, 128, 53, 155,
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    53, 33, 224, 235, 211, 190, 168, 104,
};

const byte snare[] = {
    69, 126, 249, 204, 207, 109, 205, 219,
    4, 223, 44, 181, 158, 201, 71, 143,
    51, 247, 134, 14, 88, 101, 122, 89,
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    185, 198, 70, 230, 231, 163, 142, 252,
};

const byte hat[] = {
    100, 223, 26, 104, 10, 224, 57, 11,
    10, 184, 81, 126, 87, 68, 231, 61,
    105, 173, 26, 130, 52, 58, 136, 187,
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    14, 47, 67, 226, 248, 220, 172, 21,
};

const byte crash[] = {
    124, 72, 179, 194, 231, 5, 5, 6,
    180, 241, 193, 142, 130, 223, 250, 227,
    175, 218, 9, 228, 180, 255, 65, 85,
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    24, 107, 232, 77, 175, 141, 136, 67,
};
  
  int out;
  uint16_t cnt,tmp;
  int bound;
  bool trig = false;
  int type = false;
  

ISR(TIMER1_COMPA_vect) {
   
  OCR2A = 0xff & out;

  if (type == 0) out = kick[cnt];
  if (type == 1) out = snare[cnt];
  if (type == 2) out = hat[cnt];
  if (type == 3) out = crash[cnt];

  if (trig) { trig = false; cnt = 0; } 

  if (tmp >= bound) { cnt++; tmp = 0; }

  if(cnt >= SIZE) { trig = false; out = 0; }
  
  tmp++;
  
}

void startPlayback()
{
    pinMode(SPEAKER_PIN, OUTPUT);
    pinMode(LED_PIN, OUTPUT);

    ASSR &= ~(_BV(EXCLK) | _BV(AS2));
 
    TCCR2A |= _BV(WGM21) | _BV(WGM20);
    TCCR2B &= ~_BV(WGM22);

    TCCR2A = (TCCR2A | _BV(COM2A1)) & ~_BV(COM2A0);
    TCCR2A &= ~(_BV(COM2B1) | _BV(COM2B0));

    TCCR2B = (TCCR2B & ~(_BV(CS12) | _BV(CS11))) | _BV(CS10);

    OCR2A = 0;

    cli();

    TCCR1B = (TCCR1B & ~_BV(WGM13)) | _BV(WGM12);
    TCCR1A = TCCR1A & ~(_BV(WGM11) | _BV(WGM10));

    TCCR1B = (TCCR1B & ~(_BV(CS12) | _BV(CS11))) | _BV(CS10);

    OCR1A = F_CPU / SAMPLE_RATE;

    TIMSK1 |= _BV(OCIE1A);

    sei();
    
}

void stopPlayback()
{

    TIMSK1 &= ~_BV(OCIE1A);

    TCCR1B &= ~_BV(CS10);
    TCCR2B &= ~_BV(CS10);

    digitalWrite(SPEAKER_PIN, LOW);
}


void setup() {

  startPlayback();

}


void loop() {
  
  LED_PORT ^= 1 << LED_BIT;

  trig = true;

  type = random(0, 4);
  
 // bound = random(9, 17);
    bound = map(analogRead(2),0, 1023, 9, 60);

  delay (240);
  
}
